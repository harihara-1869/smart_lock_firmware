## components/actuator/Kconfig
```kconfig
menu "Actuator"

choice ACTUATOR_BACKEND
    prompt "Actuator backend"
    default ACTUATOR_BACKEND_STUB
    help
        Selects which actuator backend is compiled behind the AAI interface.
        Exactly one is compiled; swapping is a config change, never an
        interface change.

        STUB  : honest simulated backend. Logs what it would do, simulates
                motion with a timer, and never reports success for an action
                it did not perform. This is the default for development and
                for the single-module test harnesses.
        RMT   : stepper driver via RMT (step/dir) — TODO(hardware): verify
                pin wiring and motor driver requirements.
        MCPWM : DC motor via MCPWM — TODO(hardware): verify pin wiring and
                motor driver requirements.

    config ACTUATOR_BACKEND_STUB
        bool "Stub (simulated, no hardware)"

    config ACTUATOR_BACKEND_RMT
        bool "RMT stepper backend"

    config ACTUATOR_BACKEND_MCPWM
        bool "MCPWM DC motor backend"

endchoice

config ACTUATOR_PIN_STEP
    int "Step GPIO"
    default 12
    depends on ACTUATOR_BACKEND_RMT
    help
        Stepper STEP output (RMT backend).

config ACTUATOR_PIN_DIR
    int "Direction GPIO"
    default 13
    depends on ACTUATOR_BACKEND_RMT
    help
        Stepper DIR output (RMT backend).

config ACTUATOR_PIN_PWM_A
    int "PWM output A GPIO"
    default 12
    depends on ACTUATOR_BACKEND_MCPWM
    help
        H-bridge PWM output A (MCPWM backend).

config ACTUATOR_PIN_PWM_B
    int "PWM output B GPIO"
    default 13
    depends on ACTUATOR_BACKEND_MCPWM
    help
        H-bridge PWM output B (MCPWM backend).

config ACTUATOR_PIN_LIMIT_LOCKED
    int "Locked limit-switch GPIO"
    default 4
    help
        Limit switch asserted when the bolt is fully LOCKED. -1 if not wired.

config ACTUATOR_PIN_LIMIT_UNLOCKED
    int "Unlocked limit-switch GPIO"
    default 5
    help
        Limit switch asserted when the bolt is fully UNLOCKED. -1 if not wired.

config ACTUATOR_PIN_STALL
    int "Stall-detect GPIO"
    default -1
    help
        Motor-driver stall-detection input. -1 if not wired (stall is then
        inferred from limit-switch timeout).

config ACTUATOR_MOVE_TIMEOUT_MS
    int "Actuation timeout (ms)"
    default 5000
    range 100 60000
    help
        Maximum time to drive toward a limit switch before reporting a stall.

config ACTUATOR_SIM_JAM
    bool "Simulate a jam (stub backend only)"
    default n
    depends on ACTUATOR_BACKEND_STUB
    help
        When enabled, the stub transitions to AAI_STATE_JAMMED instead of
        completing motion. Used to exercise the Application's auto-reversal
        path without hardware.

endmenu
```

## components/app_module/Kconfig
```kconfig
menu "Application Module"

config APP_PROVISION_BUTTON_GPIO
    int "Provision button GPIO"
    default 17
    range -1 48
    help
        GPIO for the physical provision button (active-low, internal pull-up,
        wired to GND on press). The press is event-driven via a GPIO ISR that
        notifies the Application task — the CPU never polls the pin.

        Hold the button for APP_PROVISION_BUTTON_HOLD_MS to arm the
        provisioning window. Set to -1 to disable the button entirely.

config APP_PROVISION_BUTTON_HOLD_MS
    int "Provision button hold duration (ms)"
    default 2000
    range 100 10000
    help
        How long the button must be held before the provisioning window is
        armed. A deliberate hold prevents accidental taps from arming it.
        (Irrelevant when APP_PROVISION_BUTTON_GPIO is -1; kept always-defined
        so the code compiles in the disabled configuration.)

config APP_PROVISION_BUTTON_DEBOUNCE_MS
    int "Provision button debounce (ms)"
    default 30
    range 1 200
    help
        Debounce window applied in task context after the ISR fires.
        (Irrelevant when APP_PROVISION_BUTTON_GPIO is -1; kept always-defined
        so the code compiles in the disabled configuration.)

endmenu
```

## components/display/Kconfig
```kconfig
menu "Display"

choice DISPLAY_BACKEND
    prompt "Display backend"
    default DISPLAY_BACKEND_CONSOLE
    help
        Selects which display backend is compiled behind the display.h
        interface. The Application decides WHAT and WHEN to show; the backend
        owns HOW it is rendered.

        CONSOLE : logs semantic indications and renders the provisioning QR
                  as ASCII/hex output. No hardware required.
        PANEL   : SPI e-paper / e-ink panel (250x122, planned). TODO(hardware):
                  implementation lands with the real panel.

    config DISPLAY_BACKEND_CONSOLE
        bool "Console (log output, no hardware)"

    config DISPLAY_BACKEND_PANEL
        bool "E-paper panel (SPI)"

endchoice

config DISPLAY_PIN_LED_GREEN
    int "Green status LED GPIO"
    default 14
    help
        Green LED used for success indication. -1 if not wired.

config DISPLAY_PIN_LED_RED
    int "Red status LED GPIO"
    default 15
    help
        Red LED used for error indication. -1 if not wired.

config DISPLAY_PIN_BUZZER
    int "Buzzer/chime GPIO"
    default 16
    help
        Buzzer output for success chime / error beeps. -1 if not wired.

config DISPLAY_PIN_PANEL_CS
    int "Panel chip-select GPIO"
    default -1
    depends on DISPLAY_BACKEND_PANEL
    help
        E-paper panel CS (SPI). -1 if not wired.

config DISPLAY_PIN_PANEL_DC
    int "Panel data/command GPIO"
    default -1
    depends on DISPLAY_BACKEND_PANEL
    help
        E-paper panel DC line. -1 if not wired.

config DISPLAY_PIN_PANEL_RST
    int "Panel reset GPIO"
    default -1
    depends on DISPLAY_BACKEND_PANEL
    help
        E-paper panel RST line. -1 if not wired.

endmenu
```

## components/integrity/Kconfig
```kconfig
menu "Integrity"

choice INTEGRITY_BACKEND
    prompt "Integrity backend"
    default INTEGRITY_BACKEND_STUB
    help
        Selects the tamper/integrity sensor backend behind integrity.h.
        The module samples and reports findings; policy (tamper lockout,
        refusing authorization) stays in the Application.

        STUB       : simulated sensor, always reports INTEGRITY_OK unless the
                     sim-tamper flag is set. No hardware required.
        TAMPER_GPIO: reads a real tamper switch. TODO(hardware): lands with
                     the sensor.

    config INTEGRITY_BACKEND_STUB
        bool "Stub (simulated, no hardware)"

    config INTEGRITY_BACKEND_TAMPER_GPIO
        bool "Tamper switch (GPIO)"

endchoice

config INTEGRITY_PIN_TAMPER
    int "Tamper switch GPIO"
    default -1
    depends on INTEGRITY_BACKEND_TAMPER_GPIO
    help
        Tamper switch input. -1 if not wired.

config INTEGRITY_SIM_TAMPER
    bool "Simulate tamper (stub backend only)"
    default n
    depends on INTEGRITY_BACKEND_STUB
    help
        When enabled, the stub reports INTEGRITY_TAMPER_DETECTED. Used to
        exercise the Application's tamper-lockout policy without hardware.

endmenu
```

## components/storage/Kconfig
```kconfig
menu "Storage"

choice STORAGE_BACKEND
    prompt "Storage backend"
    default STORAGE_BACKEND_NVS
    help
        Selects the persistence backend behind the key_store / intent_log
        seam. The Application Module talks ONLY to the interfaces in
        key_store.h and intent_log.h — swapping the backend must never change
        an application call site.

        NVS is the default: keys and intent targets survive power loss via
        the ESP32's SPI flash partition.

        The Secure Element backend is planned and is an honest stub until the
        hardware lands.

    config STORAGE_BACKEND_NVS
        bool "NVS flash backend"

    config STORAGE_BACKEND_SE
        bool "Secure Element backend (stub)"
        help
            Honest stub — every call logs TODO(hardware) and returns an error.
            Implement the real driver behind the same storage_hal.h interface
            when the hardware lands.

endchoice

endmenu
```

## main/Kconfig.projbuild
```kconfig
menu "Smart Lock Test Mode"

choice SMART_LOCK_TEST_MODE
    prompt "Application test mode"
    default TEST_MODE_FULL_APPLICATION
    help
        Selects which harness app_main() runs.

        FULL_APPLICATION  : production path — init every module in dependency
                            order, spawn the Application task, and let it
                            coordinate.
        COMM_ONLY         : comm stack (PN532/LLI/Transport/Session/Facade)
                            wired to a minimal echo/status Application loop.
                            No actuator/display/integrity init.
        ACTUATOR_ONLY     : AAI stub/backend exercised in isolation.
        DISPLAY_ONLY      : Display peer exercised in isolation.
        INTEGRITY_ONLY    : Integrity peer exercised in isolation.

        Every mode must build; each harness initializes ONLY the modules it
        needs.

    config TEST_MODE_FULL_APPLICATION
        bool "Full Application"

    config TEST_MODE_COMM_ONLY
        bool "Communication Module Only"

    config TEST_MODE_ACTUATOR_ONLY
        bool "Actuator Only"

    config TEST_MODE_DISPLAY_ONLY
        bool "Display Only"

    config TEST_MODE_INTEGRITY_ONLY
        bool "Integrity Only"

endchoice

endmenu
```
